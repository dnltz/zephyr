## boards/phytec/phyboard_lyra/phyboard_lyra_am6234_m4_defconfig
```kconfig
# PHYTEC phyBOARD-Lyra AM62x M4
#
# Copyright (C) 2023 PHYTEC Messtechnik GmbH
# Author: Daniel Schultz <d.schultz@phytec.de>
#
# SPDX-License-Identifier: Apache-2.0

# Platform Configuration
CONFIG_CORTEX_M_SYSTICK=y

# Zephyr Kernel Configuration
CONFIG_XIP=n

# Serial Driver
CONFIG_SERIAL=y
CONFIG_UART_INTERRUPT_DRIVEN=y

# GPIO Driver
CONFIG_GPIO=y

# I2C Driver
CONFIG_I2C=y

# Enable Console
CONFIG_CONSOLE=y
CONFIG_UART_CONSOLE=y
```

## drivers/gpio/Kconfig.keystone
```kconfig
# TI Keystone GPIO configuration option

# Copyright (c) 2023 Daniel Schultz <d.schultz@phytec.de>
# SPDX-License-Identifier: Apache-2.0

config GPIO_KEYSTONE
	bool "TI Keystone GPIO driver"
	default y
	depends on SOC_AM62x_M4
	help
	  Enable driver for the TI Keystone GPIO controller.

	  Says n if not sure.
```

## drivers/interrupt_controller/Kconfig.sci_intr
```kconfig
# TI Interrupt Router config

# Copyright (c) 2023 Daniel Schultz <d.schultz@phytec.de
# SPDX-License-Identifier: Apache-2.0

config SCI_INTR
	bool ""
	default y
```

## drivers/watchdog/Kconfig.davinci
```kconfig
# Copyright (c) 2024 PHYTEC Messtechnik GmbH
# SPDX-License-Identifier: Apache-2.0

config WDT_DAVINCI
	bool "TI Davinci WDT driver"
	default y
	depends on DT_HAS_TI_DAVINCI_WATCHDOG_ENABLED
	help
	  Enable the TI Davinci WDT driver.
```

## dts/bindings/gpio/ti,keystone-gpio.yaml
```yaml
# Copyright (c) 2018, SiFive Inc.
# SPDX-License-Identifier: Apache-2.0

description: TI Keystone GPIO node

compatible: "ti,keystone-gpio"

include: [gpio-controller.yaml, base.yaml]

properties:
  reg:
    required: true

  interrupts:
    required: true

gpio-cells:
  - pin
  - flags

interrupt-cells:
  - irq
  - priority
```

## dts/bindings/interrupt-controller/ti,sci-intr.yaml
```yaml
# Copyright (c) 2018 Foundries.io
# SPDX-License-Identifier: Apache-2.0

description: TI Interrupt Router

compatible: "ti,sci-intr"

include: [interrupt-controller.yaml, base.yaml]

properties:
  reg:
    required: true
  "#interrupt-cells":
    const: 2

interrupt-cells:
  - irq
  - priority
```

## dts/bindings/watchdog/ti,davinci-watchdog.yaml
```yaml
# Copyright (c) 2024 PHYTEC Messtechnik GmbH
# SPDX-License-Identifier: Apache-2.0

description: TI Davinci watchdog

compatible: "ti,davinci-watchdog"

include: base.yaml

properties:
  reg:
    required: true

  interrupts:
    required: true
```
