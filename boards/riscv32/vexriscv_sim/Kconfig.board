## boards/riscv32/vexriscv_sim/Kconfig.board
```kconfig
config BOARD_VEXRISCV_SIM
	bool "VexRiscv simulation board"
	depends on SOC_RISCV32_VEXRISCV_SIM
```

## boards/riscv32/vexriscv_sim/Kconfig.defconfig
```kconfig
if BOARD_VEXRISCV_SIM

config BOARD
	default "vexriscv_sim"

config SYS_CLOCK_HW_CYCLES_PER_SEC
	int
	default 25000000

config RISCV_RAM_BASE_ADDR
	hex
	default	0x80000000

config RISCV_RAM_SIZE
	hex
	default 0x10000

endif
```

## boards/riscv32/vexriscv_sim/vexriscv_sim_defconfig
```kconfig
CONFIG_RISCV32=y
CONFIG_SOC_SERIES_RISCV32_VEXRISCV=y
CONFIG_SOC_RISCV32_VEXRISCV_SIM=y
CONFIG_BOARD_VEXRISCV_SIM=y

CONFIG_HAS_DTS=y
CONFIG_HAS_DTS_GPIO=y

CONFIG_CONSOLE=y
CONFIG_PRINTK=y
CONFIG_SERIAL=y
CONFIG_UART_VEXRISCV=y
CONFIG_UART_CONSOLE=y

CONFIG_GPIO=y
CONFIG_GPIO_VEXRISCV=y
CONFIG_GPIO_VEXRISCV_DEV_NAME="gpio0"

CONFIG_PLIC=n
CONFIG_RISCV_MACHINE_TIMER=y
CONFIG_XIP=n
CONFIG_BOOT_BANNER=y
```

## drivers/gpio/Kconfig.vexriscv
```kconfig
# Kconfig.vexriscv - VexRiscv GPIO configuration option
#
# Copyright (c) 2019 Phytec Messtechnik GmbH
#
# SPDX-License-Identifier: Apache-2.0
#

menuconfig GPIO_VEXRISCV
	bool "VexRiscv GPIO driver"
	depends on GPIO && SOC_SERIES_RISCV32_VEXRISCV
	select HAS_DTS_GPIO
	help
	  Enable driver for the VexRiscv GPIO controller.

	  Says n if not sure.

if GPIO_VEXRISCV

config GPIO_VEXRISCV_DEV_NAME
	string "GPIO driver name"
	default "gpio0"

endif # GPIO_VEXRISCV
```

## drivers/serial/Kconfig.vexriscv
```kconfig
# Kconfig.vexriscv - VexRiscv UART configuration option
#
# Copyright (c) 2019 Phytec Messtechnik GmbH
#
# SPDX-License-Identifier: Apache-2.0
#

menuconfig UART_VEXRISCV
	bool "VexRiscv UART driver"
	depends on SOC_SERIES_RISCV32_VEXRISCV
	select SERIAL_HAS_DRIVER
	help
	  Enable the VexRiscv UART driver.
```

## dts/bindings/gpio/vexriscv,gpio.yaml
```yaml
#
# Copyright (c) 2019 Phytec Messtechnik GmbH
#
# SPDX-License-Identifier: Apache-2.0
#
---
title: VexRiscv GPIO
version: 0.1

description: >
    This is a representation of the VexRiscv GPIO nodes

properties:
    compatible:
      type: string
      category: required
      description: compatible strings
      constraint: "vexriscv,gpio"
      generation: define

    reg:
      type: int
      description: mmio register space
      generation: define
      category: required

cell_string: GPIO

"#cells":
  - pin
  - flags
...
```

## dts/bindings/serial/vexriscv,uart.yaml
```yaml
#
# Copyright (c) 2019 Phytec Messtechnik GmbH
#
# SPDX-License-Identifier: Apache-2.0
#
---
title: VexRiscv UART
version: 0.1

description: >
    This binding gives a base representation of the VEXRISCV UART

inherits:
    !include uart.yaml

properties:
    compatible:
      type: string
      category: required
      description: compatible strings
      constraint: "vexriscv,uart"
      generation: define

    reg:
      type: array
      description: mmio register space
      generation: define
      category: required

...
```

## soc/riscv32/riscv-privilege/vexriscv/Kconfig.soc
```kconfig
choice
prompt "VexRiscv implementations"
depends on SOC_SERIES_RISCV32_VEXRISCV

config SOC_RISCV32_VEXRISCV_SIM
	bool "VexRiscv simulation system implementation"
	select ATOMIC_OPERATIONS_C

endchoice
```
